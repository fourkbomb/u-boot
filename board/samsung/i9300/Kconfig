## board/samsung/i9300/Kconfig
```kconfig
if TARGET_I9300

config SYS_BOARD
	default "i9300"
	help
		Galaxy S III (3G) mobile phone support

config SYS_VENDOR
	default "samsung"

config SYS_CONFIG_NAME
	default "i9300"

endif
```

## board/samsung/midas/Kconfig
```kconfig
if TARGET_MIDAS

config SYS_BOARD
	default "midas"
	help
		Samsung Mobile's "midas" smartphone family based on Exynos 4412 support

config SYS_VENDOR
	default "samsung"

config SYS_CONFIG_NAME
	default "midas"

endif
```

## configs/midas_defconfig
```kconfig
CONFIG_ARM=y
# CONFIG_SYS_THUMB_BUILD is not set
CONFIG_ARCH_EXYNOS=y
CONFIG_SYS_TEXT_BASE=0x43e00000
CONFIG_ARCH_EXYNOS4=y
CONFIG_TARGET_MIDAS=y
CONFIG_SPL_GPIO_SUPPORT=y
CONFIG_SPL_LIBCOMMON_SUPPORT=y
CONFIG_SPL_LIBGENERIC_SUPPORT=y
CONFIG_SPL_SERIAL_SUPPORT=y
CONFIG_SPL=y
CONFIG_DEBUG_UART_BASE=0x13820000
CONFIG_DEBUG_UART_CLOCK=88473600
CONFIG_DEBUG_UART=y
CONFIG_LOCALVERSION="-midas"
CONFIG_DISTRO_DEFAULTS=y
CONFIG_FIT=y
CONFIG_FIT_BEST_MATCH=y
CONFIG_SD_BOOT=y
CONFIG_BOOTDELAY=1
# CONFIG_USE_BOOTCOMMAND is not set
CONFIG_CONSOLE_MUX=y
CONFIG_SYS_CONSOLE_INFO_QUIET=y
# CONFIG_SPL_FRAMEWORK is not set
# CONFIG_SPL_RAW_IMAGE_SUPPORT is not set
# CONFIG_SPL_LEGACY_IMAGE_SUPPORT is not set
CONFIG_CMD_CLK=y
CONFIG_CMD_DFU=y
CONFIG_CMD_GPIO=y
CONFIG_CMD_GPT=y
# CONFIG_RANDOM_UUID is not set
CONFIG_CMD_I2C=y
CONFIG_CMD_MMC=y
CONFIG_CMD_READ=y
CONFIG_CMD_USB_MASS_STORAGE=y
CONFIG_CMD_TFTPPUT=y
CONFIG_CMD_TFTPSRV=y
# CONFIG_CMD_MII is not set
CONFIG_CMD_PMIC=y
CONFIG_CMD_REGULATOR=y
CONFIG_CMD_LOG=y
# CONFIG_DOS_PARTITION is not set
# CONFIG_ISO_PARTITION is not set
CONFIG_OF_CONTROL=y
CONFIG_DEFAULT_DEVICE_TREE="exynos4412-midas"
CONFIG_OF_LIST="exynos4412-midas exynos4412-i9300 exynos4412-i9305 exynos4412-n7100 exynos4412-n7105"
CONFIG_MULTI_DTB_FIT=y
CONFIG_NETCONSOLE=y
# CONFIG_BLOCK_CACHE is not set
CONFIG_DM_EXTCON=y
CONFIG_DM_EXTCON_MAX77693=y
CONFIG_USB_FUNCTION_FASTBOOT=y
CONFIG_FASTBOOT_BUF_ADDR=0x50000000
CONFIG_FASTBOOT_BUF_SIZE=0x30000000
CONFIG_FASTBOOT_FLASH=y
CONFIG_FASTBOOT_FLASH_MMC_DEV=0
CONFIG_DM_I2C_GPIO=y
CONFIG_SYS_I2C_S3C24X0=y
CONFIG_LED=y
CONFIG_LED_AN30259A=y
# CONFIG_MMC_HW_PARTITIONING is not set
CONFIG_MMC_DW=y
CONFIG_MMC_SDHCI=y
CONFIG_MMC_SDHCI_S5P=y
# CONFIG_NETDEVICES is not set
CONFIG_PINCTRL=y
CONFIG_DM_BATTERY=y
CONFIG_DM_BATTERY_MAX17047=y
CONFIG_DM_CHARGER=y
CONFIG_DM_CHARGER_MAX77693=y
CONFIG_DM_PMIC=y
# CONFIG_SPL_PMIC_CHILDREN is not set
CONFIG_DM_PMIC_MAX17047=y
CONFIG_DM_PMIC_MAX77686=y
CONFIG_DM_PMIC_MAX77693=y
CONFIG_DM_REGULATOR=y
CONFIG_DM_REGULATOR_MAX77686=y
CONFIG_DM_REGULATOR_MAX77693=y
CONFIG_DM_REGULATOR_FIXED=y
CONFIG_DEBUG_UART_S5P=y
CONFIG_DEBUG_UART_ANNOUNCE=y
CONFIG_USB=y
CONFIG_DM_USB=y
CONFIG_USB_GADGET=y
CONFIG_USB_GADGET_MANUFACTURER="Samsung"
CONFIG_USB_GADGET_VENDOR_NUM=0x18d1
CONFIG_USB_GADGET_PRODUCT_NUM=0x4ee7
CONFIG_USB_GADGET_DWC2_OTG=y
CONFIG_USB_ETHER=y
# CONFIG_SYS_WHITE_ON_BLACK is not set
# CONFIG_HEXDUMP is not set
CONFIG_OF_LIBFDT_OVERLAY=y
CONFIG_SPL_OF_LIBFDT=y
```

## drivers/extcon/Kconfig
```kconfig
menu "Extcon support"

config DM_EXTCON
	bool "Enable Driver Model for external connector drivers (UCLASS_EXTCON)"
	depends on DM
	---help---
	This config enables driver-model support for extcon devices, which provide
	an interface to get information about currently plugged in cables.
	For more information, see these files:
	- 'include/extcon.h'
	- 'drivers/extcon/extcon-uclass.c'

config DM_EXTCON_MAX77693
	bool "Enable Driver Model for MAX77693 extcon"
	depends on DM_EXTCON
	depends on DM_PMIC_MAX77693
	---help---
	This config enables the driver-model extcon uclass features
	for MAX77693.

endmenu
```

## drivers/power/battery/Kconfig
```kconfig
config DM_BATTERY
	bool "Enable Driver Model for BATTERY drivers (UCLASS_BATTERY)"
	depends on DM
	---help---
	This config enables driver model battery support.

config DM_BATTERY_MAX17047
	bool "MAX17047 battery/fuelgauge driver"
	depends on DM_BATTERY && DM_PMIC_MAX17047
	help
	  Enable support for the fuelgauge functionality found in MAX17047.
```

## drivers/power/charger/Kconfig
```kconfig
config DM_CHARGER
	bool "Enable Driver Model for charger drivers (UCLASS_CHARGER)"
	depends on DM
	---help---
	This config enables driver model charger support.
```

## drivers/video/exynos/Kconfig
```kconfig
config DM_EXYNOS_MIPI_DSI
	bool "Enable driver model support for Exynos4 MIPI DSI"
	depends on DISPLAY && DM_VIDEO && ARCH_EXYNOS4
	default y
	help
		This enables driver model support for the MIPI DSI master
		found in Exynos4 SoCs.
```
