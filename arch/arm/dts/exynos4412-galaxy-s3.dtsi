/dts-v1/;
#include "exynos4412-midas.dts"

&fuelgauge {
	/* Following values obtained from proprietary bootloader */
	maxim,cell-character0 =
		<0xa890 0xb780 0xb9a0 0xbbf0 0xbc30 0xbc80 0xbcf0 0xbd50
		0xbe60 0xbfb0 0xc1b0 0xc4b0 0xc560 0xcce0 0xd170 0xd7a0>;

	maxim,cell-character1 =
		<0x0150 0x1000 0x0c10 0x3850 0x2e50 0x32f0 0x3040 0x12f0
		0x0fe0 0x1090 0x09e0 0x0bd0 0x0820 0x0720 0x0700 0x0700>;

	maxim,cell-character2 =
		<0x0100 0x0100 0x0100 0x0100 0x0100 0x0100 0x0100 0x0100
		0x0100 0x0100 0x0100 0x0100 0x0100 0x0100 0x0100 0x0100>;
	maxim,rcomp0 = <0x65>;
	maxim,tempco = <0x930>;
};

&ldo13_reg {
	regulator-name = "NFC_AVDD_1.8V";
};

&ldo25_reg {
	regulator-name = "LCD_VCC_3.3V";
	regulator-min-microvolt = <2800000>;
	regulator-max-microvolt = <2800000>;
};
